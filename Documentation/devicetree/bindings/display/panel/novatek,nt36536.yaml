## Documentation/devicetree/bindings/display/panel/novatek,nt36536.yaml
```yaml
# SPDX-License-Identifier: GPL-2.0-only OR BSD-2-Clause
%YAML 1.2
---
$id: http://devicetree.org/schemas/display/panel/novatek,nt36536.yaml#
$schema: http://devicetree.org/meta-schemas/core.yaml#

title: Novatek NT36536 based dual-link DSI display panels

maintainers:
  - Erwin <yzddmr7@gmail.com>

description:
  The Novatek NT36536 is a generic DSI panel IC used to drive video mode
  panels with Display Stream Compression (DSC) over two bonded DSI links,
  such as the CSOT XN242 found in the OnePlus Pad 2 Pro tablet.

allOf:
  - $ref: panel-common-dual.yaml#

properties:
  compatible:
    const: novatek,nt36536

  reg:
    maxItems: 1

  reset-gpios:
    maxItems: 1

  vddio-supply:
    description: power supply for the IC I/O interface

  backlight: true
  ports: true

required:
  - compatible
  - reg
  - vddio-supply
  - reset-gpios
  - ports

additionalProperties: false

examples:
  - |
    #include <dt-bindings/gpio/gpio.h>

    dsi {
        #address-cells = <1>;
        #size-cells = <0>;

        panel@0 {
            compatible = "novatek,nt36536";
            reg = <0>;

            vddio-supply = <&vreg_l12b_1p8>;
            reset-gpios = <&tlmm 98 GPIO_ACTIVE_LOW>;
            backlight = <&backlight>;

            ports {
                #address-cells = <1>;
                #size-cells = <0>;

                port@0 {
                    reg = <0>;
                    panel_in_0: endpoint {
                        remote-endpoint = <&dsi0_out>;
                    };
                };

                port@1 {
                    reg = <1>;
                    panel_in_1: endpoint {
                        remote-endpoint = <&dsi1_out>;
                    };
                };
            };
        };
    };

...
```

## Documentation/devicetree/bindings/leds/backlight/kinetic,ktz8866.yaml
```yaml
# SPDX-License-Identifier: (GPL-2.0 OR BSD-2-Clause)
%YAML 1.2
---
$id: http://devicetree.org/schemas/leds/backlight/kinetic,ktz8866.yaml#
$schema: http://devicetree.org/meta-schemas/core.yaml#

title: Kinetic Technologies KTZ8866/KTZ8868 backlight

maintainers:
  - Jianhua Lu <lujianhua000@gmail.com>

description: |
  The Kinetic Technologies KTZ8866 is a high efficiency 6-channels-current-sinks
  led backlight with dual lcd bias power.
  https://www.kinet-ic.com/ktz8866/

  The KTZ8868 is register compatible with the KTZ8866. Besides the HWEN pin,
  KTZ8868 designs can additionally wire ENP and ENN pins to enable the lcd
  bias outputs, hence up to three enable GPIOs.

  Without a led child node the chip registers a backlight device. A KTZ8868
  may instead describe its LED string in a led child node, which the chip
  registers as an LED class device. This allows boards that light one panel
  from several chips to combine them in a single led-backlight device.

allOf:
  - $ref: common.yaml#
  - if:
      properties:
        compatible:
          contains:
            const: kinetic,ktz8866
    then:
      properties:
        led: false
  - if:
      required:
        - led
    then:
      properties:
        current-num-sinks: false
        default-brightness: false
        max-brightness: false
        brightness-levels: false
        default-brightness-level: false

properties:
  compatible:
    enum:
      - kinetic,ktz8866
      - kinetic,ktz8868

  reg:
    maxItems: 1

  vddpos-supply:
    description: positive boost supply regulator.

  vddneg-supply:
    description: negative boost supply regulator.

  enable-gpios:
    description: GPIOs to enable the backlight (HWEN, and optionally ENP/ENN).
    minItems: 1
    maxItems: 3

  current-num-sinks:
    description:
      Number of the LED current sinks' channels, starting from LED1. Not used
      together with a led child node, whose led-sources selects the sinks.
    $ref: /schemas/types.yaml#/definitions/uint32
    enum: [1, 2, 3, 4, 5, 6]

  kinetic,current-ramp-delay-ms:
    description: |
      LED current ramping delay time in milliseconds, note that the
      case 1 will be mapped to 1μs.
    enum: [1, 2, 4, 8, 16, 32, 64, 128, 192, 256, 320, 384, 448, 512, 576, 640]

  kinetic,led-enable-ramp-delay-ms:
    description: |
      LED on/off ramping delay time in milliseconds, note that the case 0 will be
      mapped to 512μs because ktz8866 can't ramp faster than it.
    enum: [0, 1, 2, 4, 8, 16, 32, 64, 128, 256, 512, 1024, 2048, 4096, 8192, 16384]

  kinetic,enable-lcd-bias:
    description: Set if we want to output bias power supply for LCD.
    type: boolean

  led:
    type: object
    $ref: /schemas/leds/common.yaml#
    unevaluatedProperties: false
    description:
      LED string driven by the current sinks, registered as an LED class
      device instead of a backlight device.

    properties:
      led-sources:
        description:
          Current sinks the LED string is connected to. Sinks LED1 to LED6
          are numbered 0 to 5.
        minItems: 1
        maxItems: 6
        items:
          maximum: 5

    required:
      - led-sources

required:
  - compatible
  - reg

unevaluatedProperties: false

examples:
  - |
    #include <dt-bindings/gpio/gpio.h>

    i2c {
        #address-cells = <1>;
        #size-cells = <0>;

        backlight@11 {
            compatible = "kinetic,ktz8866";
            reg = <0x11>;
            vddpos-supply = <&bl_vddpos_5p5>;
            vddneg-supply = <&bl_vddneg_5p5>;
            enable-gpios = <&tlmm 139 GPIO_ACTIVE_HIGH>;
            current-num-sinks = <5>;
            kinetic,current-ramp-delay-ms = <128>;
            kinetic,led-enable-ramp-delay-ms = <1>;
            kinetic,enable-lcd-bias;
        };
    };
  - |
    #include <dt-bindings/gpio/gpio.h>
    #include <dt-bindings/leds/common.h>

    i2c {
        #address-cells = <1>;
        #size-cells = <0>;

        backlight@11 {
            compatible = "kinetic,ktz8868";
            reg = <0x11>;
            enable-gpios = <&tlmm 15 GPIO_ACTIVE_HIGH>;

            led {
                function = LED_FUNCTION_BACKLIGHT;
                color = <LED_COLOR_ID_WHITE>;
                led-sources = <0 1 2 4 5>;
            };
        };
    };
```

## Documentation/devicetree/bindings/media/i2c/chipnext,cn3927.yaml
```yaml
# SPDX-License-Identifier: (GPL-2.0-only OR BSD-2-Clause)
# Copyright (c) 2026 yading
%YAML 1.2
---
$id: http://devicetree.org/schemas/media/i2c/chipnext,cn3927.yaml#
$schema: http://devicetree.org/meta-schemas/core.yaml#

title: Chipnext CN3927 camera voice coil motor actuator

maintainers:
  - yading <yading@users.noreply.github.com>

description: |
  The CN3927 is a 10-bit voice coil motor driver for camera focus
  actuators.  The I2C register protocol uses 8-bit register addresses;
  the focus position is a 10-bit DAC split across registers 0x03
  (MSB[1:0]) and 0x04 (LSB), and the chip requires an unlock/init
  sequence before it accepts position updates.

  Hardware verified on the OnePlus Pad 2 Pro rear camera module
  (SM8750, CCI0 master 1, slave address 0x0c).

properties:
  compatible:
    const: chipnext,cn3927

  reg:
    maxItems: 1

  vio-supply:
    description: I/O voltage supply (1.8 V)

  vaf-supply:
    description: AF actuator voltage supply (2.9 V)

required:
  - compatible
  - reg
  - vio-supply
  - vaf-supply

additionalProperties: false

examples:
  - |
    i2c {
      #address-cells = <1>;
      #size-cells = <0>;

      lens@c {
        compatible = "chipnext,cn3927";
        reg = <0x0c>;
        vio-supply = <&vreg_l4b_1p8>;
        vaf-supply = <&vreg_l9b_2p9>;
      };
    };
...
```

## Documentation/devicetree/bindings/media/i2c/smartsens,sc1320cs.yaml
```yaml
# SPDX-License-Identifier: (GPL-2.0-only OR BSD-2-Clause)
# Copyright (c) 2026 yading
%YAML 1.2
---
$id: http://devicetree.org/schemas/media/i2c/smartsens,sc1320cs.yaml#
$schema: http://devicetree.org/meta-schemas/core.yaml#

title: SmartSens SC1320CS 13MP image sensor

maintainers:
  - yading <yading@users.noreply.github.com>

description: |
  The SmartSens SC1320CS is a 13MP RAW10 sensor with a 4-lane MIPI
  CSI-2 D-PHY output.  The chip identifies as 0xc658 in the 16-bit
  register 0x3107.  The native readout is 4160x3120; the driver also
  supports a 2104x1560 2x2-binned preview readout.

  On the OnePlus Pad 2 Pro (SM8750) this is the rear main sensor on
  CCI0 master 1 (I2C 0x36), fed by a 19.2 MHz MCLK whose enable bits
  sit inside the CAM_CC_TITAN_TOP_GDSC power domain, and feeding CAMSS
  CSIPHY4 at 1200 Mbps/lane (600 MHz DDR link clock).

properties:
  compatible:
    const: smartsens,sc1320cs

  reg:
    maxItems: 1

  clocks:
    maxItems: 1
    description: 19.2 MHz MCLK feeding the sensor

  clock-names:
    const: cam_clk

  power-domains:
    maxItems: 1
    description:
      Power domain gating the sensor MCLK branch (CAM_CC_TITAN_TOP_GDSC);
      with the domain off, clk_prepare_enable() on the MCLK fails with
      -EBUSY.

  reset-gpios:
    maxItems: 1

  orientation: true
  rotation: true

  cam_vana-supply:
    description: Analog supply (2.8 V)

  cam_vio-supply:
    description: I/O supply (1.8 V)

  cam_vdig-supply:
    description: Digital core supply (1.2 V)

  cam_vaf-supply:
    description: AF actuator supply (2.8 V), shared with the module VCM

  lens-focus:
    $ref: /schemas/types.yaml#/definitions/phandle
    description: Phandle to the module's focus actuator subnode

  port:
    $ref: /schemas/graph.yaml#/$defs/port-base
    additionalProperties: false

    properties:
      endpoint:
        $ref: /schemas/media/video-interfaces.yaml#
        unevaluatedProperties: false

        properties:
          data-lanes:
            description: The sensor uses four MIPI data lanes.
            minItems: 4
            maxItems: 4

          link-frequencies:
            items:
              - enum: [600000000]

        required:
          - data-lanes
          - link-frequencies

required:
  - compatible
  - reg
  - clocks
  - clock-names
  - cam_vana-supply
  - cam_vio-supply
  - cam_vdig-supply
  - cam_vaf-supply
  - port

additionalProperties: false

examples:
  - |
    #include <dt-bindings/gpio/gpio.h>

    i2c {
      #address-cells = <1>;
      #size-cells = <0>;

      sensor@36 {
        compatible = "smartsens,sc1320cs";
        reg = <0x36>;

        clocks = <&cam_bist_mclk 1>;
        clock-names = "cam_clk";
        assigned-clocks = <&cam_bist_mclk 1>;
        assigned-clock-rates = <19200000>;

        power-domains = <&titan_top_gdsc>;
        reset-gpios = <&pm8550ve_gpios 5 GPIO_ACTIVE_LOW>;

        orientation = <1>;
        rotation = <0>;

        cam_vana-supply = <&vreg_l16b_2p8>;
        cam_vio-supply = <&vreg_l4b_1p8>;
        cam_vdig-supply = <&vreg_l1i_1p2>;
        cam_vaf-supply = <&vreg_l9b_2p9>;

        port {
          endpoint {
            remote-endpoint = <&csiphy4_in>;
            data-lanes = <0 1 2 3>;
            link-frequencies = /bits/ 64 <600000000>;
          };
        };
      };
    };
...
```

## Documentation/devicetree/bindings/media/i2c/smartsens,sc820cs.yaml
```yaml
# SPDX-License-Identifier: (GPL-2.0-only OR BSD-2-Clause)
# Copyright (c) 2026 yading
%YAML 1.2
---
$id: http://devicetree.org/schemas/media/i2c/smartsens,sc820cs.yaml#
$schema: http://devicetree.org/meta-schemas/core.yaml#

title: SmartSens SC820CS 8MP image sensor

maintainers:
  - yading <yading@users.noreply.github.com>

description: |
  The SmartSens SC820CS is an 8MP RAW10 sensor with a 4-lane MIPI
  CSI-2 D-PHY output; the native readout is 3264x2448.  The chip
  identifies as 0xd154 in the 16-bit register 0x3107.

  On the OnePlus Pad 2 Pro (SM8750) this is the front sensor.  It
  sits on a plain QUP I2C bus at the 7-bit address 0x10 (the vendor
  tree's 0x20 is the 8-bit write form), is fed by a 19.2 MHz MCLK
  whose enable bits sit inside the CAM_CC_TITAN_TOP_GDSC power
  domain, and feeds CAMSS CSIPHY5.  With both PLLs closed at divider
  2 the link runs at 528 Mbps/lane (264 MHz DDR link clock).  The
  module is mounted upside down; boards describe this with
  rotation = <180>.

properties:
  compatible:
    const: smartsens,sc820cs

  reg:
    maxItems: 1

  clocks:
    maxItems: 1
    description: 19.2 MHz MCLK feeding the sensor

  power-domains:
    maxItems: 1
    description:
      Power domain gating the sensor MCLK branch (CAM_CC_TITAN_TOP_GDSC);
      with the domain off, clk_prepare_enable() on the MCLK fails with
      -EBUSY.

  reset-gpios:
    maxItems: 1

  orientation: true
  rotation: true

  dovdd-supply:
    description: I/O supply (1.8 V)

  avdd-supply:
    description: Analog supply (2.8 V)

  dvdd-supply:
    description: Digital core supply (1.2 V)

  ports:
    $ref: /schemas/graph.yaml#/properties/ports
    properties:
      port@0:
        $ref: /schemas/graph.yaml#/$defs/port-base
        additionalProperties: false

        properties:
          endpoint:
            $ref: /schemas/media/video-interfaces.yaml#
            unevaluatedProperties: false

            properties:
              data-lanes:
                description: The sensor uses four MIPI data lanes.
                minItems: 4
                maxItems: 4

              link-frequencies:
                items:
                  - enum: [264000000]

            required:
              - data-lanes
              - link-frequencies

    required:
      - port@0

required:
  - compatible
  - reg
  - clocks
  - dovdd-supply
  - avdd-supply
  - dvdd-supply
  - ports

additionalProperties: false

examples:
  - |
    #include <dt-bindings/gpio/gpio.h>

    i2c {
      #address-cells = <1>;
      #size-cells = <0>;

      sensor@10 {
        compatible = "smartsens,sc820cs";
        reg = <0x10>;

        clocks = <&cam_bist_mclk 4>;
        assigned-clocks = <&cam_bist_mclk 4>;
        assigned-clock-rates = <19200000>;

        power-domains = <&titan_top_gdsc>;
        reset-gpios = <&tlmm 7 GPIO_ACTIVE_LOW>;

        orientation = <2>;
        rotation = <180>;

        dovdd-supply = <&vreg_l4b_1p8>;
        avdd-supply = <&vreg_l16b_2p8>;
        dvdd-supply = <&vreg_l11b_1p2>;

        ports {
          #address-cells = <1>;
          #size-cells = <0>;

          port@0 {
            reg = <0>;

            endpoint {
              remote-endpoint = <&csiphy5_in>;
              data-lanes = <0 1 2 3>;
              link-frequencies = /bits/ 64 <264000000>;
            };
          };
        };
      };
    };
...
```
